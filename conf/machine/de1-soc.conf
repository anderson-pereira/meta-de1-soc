## conf/machine/de1-soc.conf
```bitbake
#@TYPE: Machine
#@NAME: cyclone5
#@DESCRIPTION: Machine configuration for the Cyclone V SoC" 

require conf/machine/include/socfpga.inc

# this variable specifies the kernel to be built: linux-altera or linux-altera-ltsi
# this affects the PREFERRED_PROVIDER of virtual/kernel
# it can be overriden from the environment, using BB_ENV_EXTRAWHITE
KERNEL_PROVIDER ?= "linux-altera-lts"
PREFERRED_PROVIDER_virtual/kernel ?= "${KERNEL_PROVIDER}"

PREFERRED_PROVIDER_virtual/bootloader ?= "u-boot-socfpga"
PREFERRED_PROVIDER_u-boot ?= "u-boot-socfpga"

KMACHINE = "de1-soc"

KBUILD_DEFCONFIG ?= "socfpga_defconfig"
KCONFIG_MODE ?= "--alldefconfig"

# IMAGE_BOOTLOADER = ""
# PREFERRED_PROVIDER_virtual/bootloader = "u-boot-with-spl"

# Default kernel devicetrees
KERNEL_DEVICETREE ?= "socfpga_cyclone5_socdk.dtb"
SERIAL_CONSOLES ?= "115200;ttyS0"

# u-boot setup
# UBOOT_EXTLINUX ?= "1"
# UBOOT_EXTLINUX_LABELS ?= "default"
# UBOOT_EXTLINUX_DEFAULT_LABEL ?= "Cyclone5 SOCDK SDMMC"

# UBOOT_EXTLINUX_FDT:default ?= "../socfpga_cyclone5_socdk.dtb"
# UBOOT_EXTLINUX_ROOT:default ?= "root=/dev/mmcblk0p3"
# UBOOT_EXTLINUX_MENU_DESCRIPTION:default ?= "Cyclone5 SOCDK SDMMC"
# UBOOT_EXTLINUX_KERNEL_IMAGE:default ?= "../${KERNEL_IMAGETYPE}"
# UBOOT_EXTLINUX_FDTDIR:default ?= "../"
# UBOOT_EXTLINUX_KERNEL_ARGS:default ?= "rootwait rw earlycon"

IMAGE_BOOT_FILES ?= " \
	${KERNEL_DEVICETREE};socfpga.dtb \
	${KERNEL_IMAGETYPE} \
	u-boot.scr;u-boot.scr \
	"

EXTRA_IMAGECMD_jffs2 ?= "-e 0x10000"

WKS_FILE ?= "sdimage-cyclone5-arria5.wks"
IMAGE_FSTYPES +="wic"
```

## conf/machine/include/socfpga.inc
```bitbake
SOC_FAMILY = "socfpga"

require conf/machine/include/arm/armv7a/tune-cortexa9.inc

# Increase this everytime you change something in the kernel
MACHINE_KERNEL_PR = "r1"

# UBOOT_ENTRYPOINT = "0x80008000"
# UBOOT_LOADADDRESS = "0x80008000"

KERNEL_IMAGETYPE ?= "zImage"
MACHINE_EXTRA_RRECOMMENDS = " kernel-modules"
MACHINE_FEATURES = "kernel26"

# file system images required
IMAGE_FSTYPES ?= "cpio ext3 tar.gz jffs2"

# u-boot setup
# UBOOT_SUFFIX ?= "sfp"
# UBOOT_BINARY ?= "u-boot-with-spl.${UBOOT_SUFFIX}"

do_image_wic[depends] += "mtools-native:do_populate_sysroot dosfstools-native:do_populate_sysroot virtual/bootloader:do_deploy virtual/kernel:do_deploy"
```

## wic/sdimage-cyclone5-arria5.wks
```
# short-description: Create an SD card image for the Cyclone 5 and Arria 5 SoCs
# long-description: Create an SD card image for the Cyclone 5 and Arria 5 SoCs.
# Boot files are located in the first vfat partition and u-Boot is located in
# the third partition.

part --source bootimg-partition --ondisk mmcblk --fstype=vfat --label boot --active --align 1024 --size 128M
part / --source rootfs --ondisk mmcblk --fstype=ext4 --label root --align 1024
part --source rawcopy --sourceparams="file=U-Boot-2013.01.01.spl" --ondisk mmcblk --system-id=a2 --align 1024 --fixed-size 1M
```
